## esp32/main/Kconfig.projbuild
```kconfig
menu "Petri"

choice PETRI_APP
    prompt "Application"
    default PETRI_APP_SELFTEST

config PETRI_APP_SELFTEST
    bool "Core self-test"

config PETRI_APP_LINKTEST
    bool "SPI link test with the SAMD51"

endchoice

config PETRI_BLE_ADVERTISE
    bool "Advertise over Bluetooth LE with NimBLE during the self-test"
    depends on BT_NIMBLE_ENABLED
    default n
    help
        Starts NimBLE and advertises as "Petri" before the self-test so the
        heap and timing results include the radio stack.

endmenu
```

## esp32/sdkconfig.defaults
```kconfig
CONFIG_ESPTOOLPY_FLASHSIZE_4MB=y
CONFIG_ESP_DEFAULT_CPU_FREQ_MHZ_240=y
CONFIG_COMPILER_OPTIMIZATION_PERF=y
CONFIG_ESP_MAIN_TASK_STACK_SIZE=8192
CONFIG_FREERTOS_HZ=1000
# No radio in the baseline build.
CONFIG_BT_ENABLED=n
```
